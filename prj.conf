## CMakeLists.txt
```
# SPDX-License-Identifier: Apache-2.0

cmake_minimum_required(VERSION 3.20.0)
find_package(Zephyr REQUIRED HINTS $ENV{ZEPHYR_BASE})
project(serial_to_hog)

FILE(GLOB app_sources src/*.c)
target_sources(app PRIVATE ${app_sources})
```

## Kconfig
```
# Copyright 2023 Google LLC
# SPDX-License-Identifier: Apache-2.0

mainmenu "HID over GATT (HoG) Bridge"

source "Kconfig.zephyr"
```

## prj.conf
```kconfig
# Increased stack due to settings API usage
CONFIG_SYSTEM_WORKQUEUE_STACK_SIZE=2048

CONFIG_BT=y
CONFIG_LOG=y
CONFIG_BT_SMP=y
CONFIG_BT_PERIPHERAL=y
CONFIG_BT_DIS=y
CONFIG_BT_BAS=y
CONFIG_BT_DEVICE_NAME="HoG Bridge"
CONFIG_BT_DEVICE_APPEARANCE=960
CONFIG_BT_MAX_CONN=4
CONFIG_BT_SMP_APP_PAIRING_ACCEPT=y
CONFIG_BT_MAX_PAIRED=8
CONFIG_BT_SMP_ALLOW_UNAUTH_OVERWRITE=y
CONFIG_BT_KEYS_OVERWRITE_OLDEST=y
CONFIG_BT_KEYS_SAVE_AGING_COUNTER_ON_PAIRING=y
CONFIG_BT_GATT_ENFORCE_SUBSCRIPTION=n

CONFIG_BT_PERIPHERAL_PREF_MIN_INT=6
CONFIG_BT_PERIPHERAL_PREF_MAX_INT=10
CONFIG_BT_PERIPHERAL_PREF_LATENCY=0
CONFIG_BT_PERIPHERAL_PREF_TIMEOUT=10

CONFIG_BT_SETTINGS=y
CONFIG_FLASH=y
CONFIG_FLASH_MAP=y
CONFIG_NVS=y
CONFIG_SETTINGS=y

CONFIG_GPIO=y

CONFIG_USB_DEVICE_STACK=y
CONFIG_USB_DEVICE_PRODUCT="Zephyr CDC ACM sample"
CONFIG_USB_DEVICE_VID=0x1234
CONFIG_USB_DEVICE_PID=0x5678
CONFIG_USB_DEVICE_INITIALIZE_AT_BOOT=n

CONFIG_UART_INTERRUPT_DRIVEN=y
CONFIG_UART_LINE_CTRL=y

CONFIG_LOG=y
CONFIG_SERIAL=y
CONFIG_STDOUT_CONSOLE=y
```

## app.overlay
```dts
/*
 * Copyright (c) 2021 Nordic Semiconductor ASA
 *
 * SPDX-License-Identifier: Apache-2.0
 */

/ {
    chosen {
        serial_to_hogp,serial = &cdc_acm_uart0;
		serial_to_hogp,status-led = &led0;
    };
};

&zephyr_udc0 {
	cdc_acm_uart0: cdc_acm_uart0 {
		compatible = "zephyr,cdc-acm-uart";
		label = "Zephyr USB CDC-ACM";
	};
};
```

## src/main.c
```c
/*
 * Copyright (c) 2016 Intel Corporation
 *
 * SPDX-License-Identifier: Apache-2.0
 */

#include <stddef.h>
#include <string.h>
#include <zephyr/device.h>
#include <zephyr/drivers/uart.h>
#include <zephyr/kernel.h>
#include <zephyr/sys/byteorder.h>
#include <zephyr/sys/printk.h>
#include <zephyr/types.h>
#include <zephyr/usb/usb_device.h>

#include <zephyr/settings/settings.h>

#include <zephyr/bluetooth/bluetooth.h>
#include <zephyr/bluetooth/conn.h>
#include <zephyr/bluetooth/gatt.h>
#include <zephyr/bluetooth/hci.h>
#include <zephyr/bluetooth/uuid.h>
#include <zephyr/drivers/gpio.h>

#include "adv.h"
#include "hog.h"
#include "pair.h"
#include "registry.h"
#include "zephyr/bluetooth/addr.h"
#include "zephyr/bluetooth/gap.h"
#include "zephyr/sys/ring_buffer.h"

LOG_MODULE_REGISTER(main);

const struct device *const uart_dev = DEVICE_DT_GET(DT_CHOSEN(serial_to_hogp_serial));
RING_BUF_DECLARE(uart_rx_buf, 2048);
RING_BUF_DECLARE(uart_tx_buf, 2048);

static const struct gpio_dt_spec led = GPIO_DT_SPEC_GET(DT_CHOSEN(serial_to_hogp_status_led), gpios);

static void start_adv_handler(struct k_work *work) {
  stop_adv();
  if (is_control_blocks_full()) {
    return;
  }
  start_adv(count_connected_devices() == 0
                ? BT_LE_ADV_PARAM(BT_LE_ADV_OPT_CONN, BT_GAP_ADV_FAST_INT_MIN_1, BT_GAP_ADV_FAST_INT_MAX_1, NULL)
                : BT_LE_ADV_PARAM(BT_LE_ADV_OPT_CONN, BT_GAP_ADV_SLOW_INT_MIN, BT_GAP_ADV_SLOW_INT_MAX, NULL));
  gpio_pin_set_dt(&led, count_connected_devices() > 0 ? 1 : 0);
}
K_WORK_DEFINE(start_adv_work, start_adv_handler);

typedef struct {
  bool connected;
  uint16_t conn_id;
  uint8_t addr[6];
} __attribute__((packed)) uart_connected_device_t;
static void send_connections_handler(struct k_work *work) {
  uart_connected_device_t devices[CONFIG_BT_MAX_CONN];
  memset(devices, 0, sizeof(devices));

  int count = 0;

  for (int i = 0; i < CONFIG_BT_MAX_CONN; i++) {
    control_block_t *cb = get_control_block_by_index(i);
    if (cb) {
      devices[i].connected = true;
      devices[i].conn_id = i;
      devices[i].addr[0] = cb->addr.a.val[5];
      devices[i].addr[1] = cb->addr.a.val[4];
      devices[i].addr[2] = cb->addr.a.val[3];
      devices[i].addr[3] = cb->addr.a.val[2];
      devices[i].addr[4] = cb->addr.a.val[1];
      devices[i].addr[5] = cb->addr.a.val[0];
      count++;
    }
  }

  uint8_t preamble[] = {1, 2, 4, 5};
  ring_buf_put(&uart_tx_buf, preamble, sizeof(preamble));
  ring_buf_put(&uart_tx_buf, (uint8_t *)&devices, sizeof(devices));
  uart_irq_tx_enable(uart_dev);

  LOG_INF("Sending %d connected devices", count);
}
K_WORK_DEFINE(send_connections_work, send_connections_handler);

static void connected(struct bt_conn *conn, uint8_t err) {
  char addr[BT_ADDR_LE_STR_LEN];
  bt_addr_le_to_str(bt_conn_get_dst(conn), addr, sizeof(addr));

  if (err) {
    LOG_ERR("Failed to connect to %s, err 0x%02x %s", addr, err, bt_hci_err_to_str(err));
    return;
  }

  LOG_INF("Connected to %s", addr);

  err = bt_conn_set_security(conn, BT_SECURITY_L2);
  if (err) {
    LOG_ERR("Failed to set security (err %d)", err);
  }

  register_connection(conn);

  err = bt_conn_le_param_update(conn, BT_LE_CONN_PARAM(6, 10, 0, 10));
  if (err) {
    LOG_ERR("Failed to update connection parameters (err %d)", err);
    return;
  }

  k_work_submit(&start_adv_work);
  k_work_submit(&send_connections_work);
}

static void disconnected(struct bt_conn *conn, uint8_t reason) {

  char addr[BT_ADDR_LE_STR_LEN];
  bt_addr_le_to_str(bt_conn_get_dst(conn), addr, sizeof(addr));
  LOG_INF("Disconnected from %s, reason 0x%02x %s", addr, reason, bt_hci_err_to_str(reason));

  unregister_connection(conn);

  k_work_submit(&start_adv_work);
  k_work_submit(&send_connections_work);
}

static void security_changed(struct bt_conn *conn, bt_security_t level, enum bt_security_err err) {
  char addr[BT_ADDR_LE_STR_LEN];
  bt_addr_le_to_str(bt_conn_get_dst(conn), addr, sizeof(addr));

  if (!err) {
    LOG_INF("Security changed: %s level %u", addr, level);
  } else {
    LOG_ERR("Security failed: %s level %u err %s(%d)", addr, level, bt_security_err_to_str(err), err);
  }
}

static void le_param_updated(struct bt_conn *conn, uint16_t interval, uint16_t latency, uint16_t timeout) {
  char addr[BT_ADDR_LE_STR_LEN];
  bt_addr_le_to_str(bt_conn_get_dst(conn), addr, sizeof(addr));
  LOG_INF("LE parameters updated: %s interval %u latency %u timeout %u", addr, interval, latency, timeout);
}

BT_CONN_CB_DEFINE(conn_callbacks) = {
    .connected = connected,
    .disconnected = disconnected,
    .security_changed = security_changed,
    .le_param_updated = le_param_updated,
};

static void bt_ready(int err) {
  if (err) {
    LOG_ERR("Bluetooth init failed (err %d)", err);
    return;
  }

  LOG_INF("Bluetooth ready");

  hog_init();

  if (IS_ENABLED(CONFIG_SETTINGS)) {
    settings_load();
  }

  k_work_submit(&start_adv_work);
}

typedef union {
  struct {
    uint8_t command;
    uint8_t padding[3];
  } any;
  struct {
    uint8_t command;
    uint8_t conn_id;
    uint8_t report_id;
    uint8_t report_len;
  } send_report;
} command_header_t;

#define REPORT_LEN_MAX (8)
typedef struct {
  uint8_t conn_id;
  uint8_t report_id;
  uint8_t report_len;
  uint8_t report[REPORT_LEN_MAX];
} report_message_t;

K_MSGQ_DEFINE(report_msgq, sizeof(report_message_t), 128, 1);

static void uart_interrupt_handler(const struct device *dev, void *user_data) {
  ARG_UNUSED(user_data);

  while (uart_irq_update(dev) && uart_irq_is_pending(dev)) {
    if (uart_irq_rx_ready(dev)) {
      uint8_t local_buf[64];

      int recv_len = uart_fifo_read(dev, local_buf, sizeof(local_buf));
      if (recv_len > 0) {
        ring_buf_put(&uart_rx_buf, local_buf, recv_len);
      }

      while (ring_buf_size_get(&uart_rx_buf) >= sizeof(command_header_t)) {
        command_header_t header;
        ring_buf_peek(&uart_rx_buf, (uint8_t *)&header, sizeof(command_header_t));

        switch (header.any.command) {
        case 0xF0: {
          uint8_t report_len = MIN(header.send_report.report_len, REPORT_LEN_MAX);
          uint8_t combined_len = sizeof(command_header_t) + report_len;
          if (ring_buf_size_get(&uart_rx_buf) >= combined_len) {
            // We have enough data, drop the header
            ring_buf_get(&uart_rx_buf, NULL, sizeof(command_header_t));

            report_message_t report_msg = {
                .conn_id = header.send_report.conn_id,
                .report_id = header.send_report.report_id,
                .report_len = report_len,
            };
            ring_buf_get(&uart_rx_buf, report_msg.report, report_len);
            k_msgq_put(&report_msgq, &report_msg, K_NO_WAIT); // Silently drop if full
          }
          break;
        }
        case 0xF1:
          // Request connected devices
          // Drop the header
          ring_buf_get(&uart_rx_buf, NULL, sizeof(command_header_t));

          // Send connected devices
          k_work_submit(&send_connections_work);
          break;
        default:
          // Drop the header
          ring_buf_get(&uart_rx_buf, NULL, sizeof(command_header_t));
          break;
        }
      }
    }

    if (uart_irq_tx_ready(dev)) {
      uint8_t local_buf[64];
      int rb_len;

      rb_len = ring_buf_get(&uart_tx_buf, local_buf, sizeof(local_buf));
      if (rb_len == 0) {
        uart_irq_tx_disable(dev);
      } else {
        uart_fifo_fill(dev, local_buf, rb_len);
        if (ring_buf_is_empty(&uart_tx_buf)) {
          // No more data to send, disable TX interrupt
          // otherwise it will keep sending empty data
          uart_irq_tx_disable(dev);
        }
      }
    }
  }
}

int main(void) {
  int err;

  err = usb_enable(NULL);
  if (err) {
    return 0;
  }

  if (!device_is_ready(uart_dev)) {
    LOG_ERR("UART device not ready");
    return 0;
  }

  if (!gpio_is_ready_dt(&led)) {
    LOG_ERR("LED device not ready");
    return 0;
  }

  err = gpio_pin_configure_dt(&led, GPIO_OUTPUT_INACTIVE);
  if (err) {
    LOG_ERR("Failed to configure LED pin (err %d)", err);
    return 0;
  }

  err = uart_irq_callback_set(uart_dev, uart_interrupt_handler);
  if (err) {
    LOG_ERR("Failed to set UART IRQ (err %d)", err);
    return 0;
  }
  uart_irq_rx_enable(uart_dev);

  err = bt_enable(bt_ready);
  if (err) {
    LOG_ERR("Bluetooth init failed (err %d)", err);
    return 0;
  }

  err = register_auth_callbacks();
  if (err) {
    LOG_ERR("Failed to register auth callbacks (err %d)", err);
    return 0;
  }

  while (1) {
    report_message_t report_msg;
    k_msgq_get(&report_msgq, &report_msg, K_FOREVER);
    control_block_t *cb = get_control_block_by_index(report_msg.conn_id);
    if (cb) {
      hog_notify(cb->conn, report_msg.report_id, report_msg.report, report_msg.report_len);
    } else {
      LOG_ERR("Connection %d not found", report_msg.conn_id);
    }
  }

  return 0;
}
```

## src/adv.c
```c
#include <zephyr/bluetooth/bluetooth.h>
#include <zephyr/bluetooth/conn.h>
#include <zephyr/bluetooth/gatt.h>
#include <zephyr/bluetooth/hci.h>
#include <zephyr/bluetooth/uuid.h>
#include <zephyr/kernel.h>
#include <zephyr/logging/log.h>

#include "adv.h"

LOG_MODULE_REGISTER(adv);

static bool adv_enabled = false;

static const struct bt_data ad[] = {
    BT_DATA_BYTES(BT_DATA_FLAGS, (BT_LE_AD_GENERAL | BT_LE_AD_NO_BREDR)),
    BT_DATA_BYTES(BT_DATA_UUID16_ALL, BT_UUID_16_ENCODE(BT_UUID_HIDS_VAL), BT_UUID_16_ENCODE(BT_UUID_BAS_VAL)),
};

static const struct bt_data sd[] = {
    BT_DATA(BT_DATA_NAME_COMPLETE, CONFIG_BT_DEVICE_NAME, sizeof(CONFIG_BT_DEVICE_NAME) - 1),
};

void start_adv(const struct bt_le_adv_param *param) {
  int err = bt_le_adv_start(param, ad, ARRAY_SIZE(ad), sd, ARRAY_SIZE(sd));
  if (err) {
    LOG_ERR("Failed to start advertising (err %d)", err);
    return;
  }

  LOG_INF("Advertising started");
  adv_enabled = true;
}

void stop_adv(void) {
  int err = bt_le_adv_stop();
  if (err) {
    LOG_ERR("Failed to stop advertising (err %d)", err);
    return;
  }

  LOG_INF("Advertising stopped");
  adv_enabled = false;
}
```

## src/adv.h
```c
#pragma once

#include <zephyr/bluetooth/bluetooth.h>

void start_adv(const struct bt_le_adv_param *param);
void stop_adv(void);
```

## src/hog.c
```c
/*
 * Copyright (c) 2016 Intel Corporation
 *
 * SPDX-License-Identifier: Apache-2.0
 */

#include <stddef.h>
#include <string.h>
#include <zephyr/drivers/gpio.h>
#include <zephyr/kernel.h>
#include <zephyr/sys/byteorder.h>
#include <zephyr/sys/printk.h>
#include <zephyr/types.h>

#include <zephyr/bluetooth/bluetooth.h>
#include <zephyr/bluetooth/conn.h>
#include <zephyr/bluetooth/gatt.h>
#include <zephyr/bluetooth/hci.h>
#include <zephyr/bluetooth/uuid.h>

#include "hog.h"
#include "zephyr/logging/log.h"

LOG_MODULE_REGISTER(hog);

enum {
  HIDS_INPUT = 0x01,
  HIDS_OUTPUT = 0x02,
  HIDS_FEATURE = 0x03,
};

static uint8_t report_map[] = {
    0x05, 0x01,              // Usage Page (Generic Desktop)        0
    0x09, 0x06,              // Usage (Keyboard)                    2
    0xa1, 0x01,              // Collection (Application)            4
    0x85, HID_RPT_ID_KEY_IN, //  Report ID (2)                      6
    // Modifier
    0x95, 0x08, //  Report Count (8)                   8
    0x75, 0x01, //  Report Size (1)                    10
    0x15, 0x00, //  Logical Minimum (0)                12
    0x25, 0x01, //  Logical Maximum (1)                14
    0x05, 0x07, //  Usage Page (Keyboard)              16
    0x19, 0xe0, //  Usage Minimum (224)                18
    0x29, 0xe7, //  Usage Maximum (231)                20
    0x81, 0x02, //  Input (Data,Var,Abs)               22
    // Main Keys
    0x95, 0x06,       //  Report Count (6)                   24
    0x75, 0x08,       //  Report Size (8)                    26
    0x15, 0x00,       //  Logical Minimum (0)                28
    0x26, 0xff, 0x00, //  Logical Maximum (255)              30
    0x05, 0x07,       //  Usage Page (Keyboard)              33
    0x19, 0x00,       //  Usage Minimum (0)                  35
    0x2a, 0xff, 0x00, //  Usage Maximum (255)                37
    0x81, 0x00,       //  Input (Data,Arr,Abs)               40
    // LED Output (5+3)
    0x85, HID_RPT_ID_LED_OUT, //  Report ID (2)                      42
    0x05, 0x08,               //  Usage Page (LEDs)                  44
    0x95, 0x05,               //  Report Count (5)                   46
    0x75, 0x01,               //  Report Size (1)                    48
    0x15, 0x00,               //  Logical Minimum (0)                50
    0x25, 0x01,               //  Logical Maximum (1)                52
    0x19, 0x01,               //  Usage Minimum (1)                  54
    0x29, 0x05,               //  Usage Maximum (5)                  56
    0x91, 0x02,               //  Output (Data,Var,Abs)              58
    0x95, 0x01,               //  Report Count (1)                   60
    0x75, 0x03,               //  Report Size (3)                    62
    0x91, 0x01,               //  Output (Cnst,Arr,Abs)              64
    0xc0,                     // End Collection                      66

    0x05, 0x01,                // Usage Page (Generic Desktop)        67
    0x09, 0x02,                // Usage (Mouse)                       69
    0xa1, 0x01,                // Collection (Application)            71
    0x85, HID_RPT_ID_MOUSE_IN, //  Report ID (1)                      73
    0x09, 0x01,                //  Usage (Pointer)                    75
    0xa1, 0x00,                //  Collection (Physical)              77
    // 16 Buttons
    0x05, 0x09, //   Usage Page (Button)               79
    0x19, 0x01, //   Usage Minimum (1)                 81
    0x29, 0x10, //   Usage Maximum (16)                83
    0x15, 0x00, //   Logical Minimum (0)               85
    0x25, 0x01, //   Logical Maximum (1)               87
    0x95, 0x10, //   Report Count (16)                 89
    0x75, 0x01, //   Report Size (1)                   91
    0x81, 0x02, //   Input (Data,Var,Abs)              93
    // X/Y Motion
    0x05, 0x01,       //   Usage Page (Generic Desktop)      95
    0x16, 0x01, 0x80, //   Logical Minimum (-32767)          97
    0x26, 0xff, 0x7f, //   Logical Maximum (32767)           100
    0x75, 0x10,       //   Report Size (16)                  103
    0x95, 0x02,       //   Report Count (2)                  105
    0x09, 0x30,       //   Usage (X)                         107
    0x09, 0x31,       //   Usage (Y)                         109
    0x81, 0x06,       //   Input (Data,Var,Rel)              111
    0x15, 0x81,       //   Logical Minimum (-127)            113
    0x25, 0x7f,       //   Logical Maximum (127)             115
    // Vertical Wheel
    0x75, 0x08, //   Report Size (8)                   117
    0x95, 0x01, //   Report Count (1)                  119
    0x09, 0x38, //   Usage (Wheel)                     121
    0x81, 0x06, //   Input (Data,Var,Rel)              123
    // Horizontal Wheel
    0x05, 0x0c,             //   Usage Page (Consumer Devices)     125
    0x0a, 0x38, 0x02,       //   Usage (AC Pan)                    127
    0x95, 0x01,             //   Report Count (1)                  130
    0x81, 0x06,             //   Input (Data,Var,Rel)              132
    0xc0,                   //  End Collection                     134
    0xc0,                   // End Collection                      135
    0x05, 0x0c,             // Usage Page (Consumer Devices)       136
    0x09, 0x01,             // Usage (Consumer Control)            138
    0xa1, 0x01,             // Collection (Application)            140
    0x85, HID_RPT_ID_CC_IN, //  Report ID (3)                      142
    // 2 * 16-bit usage IDs
    0x75, 0x10,       //  Report Size (16)                   144
    0x95, 0x02,       //  Report Count (2)                   146
    0x15, 0x01,       //  Logical Minimum (1)                148
    0x26, 0xff, 0x02, //  Logical Maximum (767)              150
    0x19, 0x01,       //  Usage Minimum (1)                  153
    0x2a, 0xff, 0x02, //  Usage Maximum (767)                155
    0x81, 0x00,       //  Input (Data,Arr,Abs)               158
    0xc0,             // End Collection                      160
};

typedef struct {
  uint16_t len;
  void *buf;
} fixed_read_info;

#define FIXED_READ_INFO(_info_name, _name)                                                                             \
  fixed_read_info _info_name = {                                                                                       \
      .len = sizeof(_name),                                                                                            \
      .buf = &_name,                                                                                                   \
  }

struct hids_info {
  uint16_t version; /* version number of base USB HID Specification */
  uint8_t code;     /* country HID Device hardware is localized for. */
  uint8_t flags;
} __packed;
enum {
  HIDS_REMOTE_WAKE = BIT(0),
  HIDS_NORMALLY_CONNECTABLE = BIT(1),
};

static struct hids_info hid_info = {
    .version = 0x0000,
    .code = 0x00,
    .flags = HIDS_NORMALLY_CONNECTABLE,
};
FIXED_READ_INFO(hid_info_read_info, hid_info);
FIXED_READ_INFO(hid_report_map_read_info, report_map);

struct hids_report {
  uint8_t id;   /* report id */
  uint8_t type; /* report type */
} __packed;
static struct hids_report mouse_ref = {
    .id = HID_RPT_ID_MOUSE_IN,
    .type = HIDS_INPUT,
};
FIXED_READ_INFO(mouse_ref_read_info, mouse_ref);
static struct hids_report keyboard_ref = {
    .id = HID_RPT_ID_KEY_IN,
    .type = HIDS_INPUT,
};
FIXED_READ_INFO(keyboard_ref_read_info, keyboard_ref);
static struct hids_report cc_ref = {
    .id = HID_RPT_ID_CC_IN,
    .type = HIDS_INPUT,
};
FIXED_READ_INFO(cc_ref_read_info, cc_ref);
static struct hids_report led_ref = {
    .id = HID_RPT_ID_LED_OUT,
    .type = HIDS_OUTPUT,
};
FIXED_READ_INFO(led_ref_read_info, led_ref);

static ssize_t fixed_read(struct bt_conn *conn, const struct bt_gatt_attr *attr, void *buf, uint16_t len,
                          uint16_t offset) {
  fixed_read_info *info = attr->user_data;
  if (info == NULL) {
    return 0;
  }

  char uuid[BT_UUID_STR_LEN];
  char addr[BT_ADDR_LE_STR_LEN];
  bt_addr_le_to_str(bt_conn_get_dst(conn), addr, sizeof(addr));
  bt_uuid_to_str(attr->uuid, uuid, sizeof(uuid));
  LOG_DBG("Read %s %u@%u from %s", uuid, len, offset, addr);

  return bt_gatt_attr_read(conn, attr, buf, len, offset, info->buf, info->len);
}

static void input_ccc_changed(const struct bt_gatt_attr *attr, uint16_t value) {
  char uuid[BT_UUID_STR_LEN];
  bt_uuid_to_str(attr->uuid, uuid, sizeof(uuid));
  LOG_DBG("CCC changed %s to %u", uuid, value);
}

static ssize_t read_noop(struct bt_conn *conn, const struct bt_gatt_attr *attr, void *buf, uint16_t len,
                         uint16_t offset) {
  char uuid[BT_UUID_STR_LEN];
  char addr[BT_ADDR_LE_STR_LEN];
  bt_addr_le_to_str(bt_conn_get_dst(conn), addr, sizeof(addr));
  bt_uuid_to_str(attr->uuid, uuid, sizeof(uuid));
  LOG_DBG("Read %s %u@%u from %s", uuid, len, offset, addr);

  return bt_gatt_attr_read(conn, attr, buf, len, offset, NULL, 0);
}

static ssize_t write_noop(struct bt_conn *conn, const struct bt_gatt_attr *attr, const void *buf, uint16_t len,
                          uint16_t offset, uint8_t flags) {
  char uuid[BT_UUID_STR_LEN];
  char addr[BT_ADDR_LE_STR_LEN];
  bt_addr_le_to_str(bt_conn_get_dst(conn), addr, sizeof(addr));
  bt_uuid_to_str(attr->uuid, uuid, sizeof(uuid));
  LOG_DBG("Write %s %u@%u from %s", uuid, len, offset, addr);

  return len;
}

#define SAMPLE_BT_PERM_READ BT_GATT_PERM_READ_ENCRYPT
#define SAMPLE_BT_PERM_WRITE BT_GATT_PERM_WRITE_ENCRYPT

static struct bt_gatt_ccc_managed_user_data mouse_ccc =
    BT_GATT_CCC_MANAGED_USER_DATA_INIT(input_ccc_changed, NULL, NULL);
static struct bt_gatt_ccc_managed_user_data keyboard_ccc =
    BT_GATT_CCC_MANAGED_USER_DATA_INIT(input_ccc_changed, NULL, NULL);
static struct bt_gatt_ccc_managed_user_data cc_ccc = BT_GATT_CCC_MANAGED_USER_DATA_INIT(input_ccc_changed, NULL, NULL);

#define HID_INPUT_REPORT_CHARACTERISTIC(_ccc, _ref_read_info)                                                          \
  BT_GATT_CHARACTERISTIC(BT_UUID_HIDS_REPORT, BT_GATT_CHRC_READ | BT_GATT_CHRC_NOTIFY, SAMPLE_BT_PERM_READ, read_noop, \
                         NULL, &_ref_read_info),                                                                       \
      BT_GATT_CCC_MANAGED(&_ccc, SAMPLE_BT_PERM_READ | SAMPLE_BT_PERM_WRITE),                                          \
      BT_GATT_DESCRIPTOR(BT_UUID_HIDS_REPORT_REF, BT_GATT_PERM_READ, fixed_read, NULL, &_ref_read_info)

#define HID_OUTPUT_REPORT_CHARACTERISTIC(_ref_read_info)                                                               \
  BT_GATT_CHARACTERISTIC(BT_UUID_HIDS_REPORT,                                                                          \
                         BT_GATT_CHRC_READ | BT_GATT_CHRC_WRITE | BT_GATT_CHRC_WRITE_WITHOUT_RESP,                     \
                         SAMPLE_BT_PERM_READ | SAMPLE_BT_PERM_WRITE, read_noop, write_noop, NULL),                     \
      BT_GATT_DESCRIPTOR(BT_UUID_HIDS_REPORT_REF, BT_GATT_PERM_READ, fixed_read, NULL, &_ref_read_info)

/* HID Service Declaration */
BT_GATT_SERVICE_DEFINE(hog_svc, BT_GATT_PRIMARY_SERVICE(BT_UUID_HIDS),

                       HID_INPUT_REPORT_CHARACTERISTIC(mouse_ccc, mouse_ref_read_info),
                       HID_INPUT_REPORT_CHARACTERISTIC(keyboard_ccc, keyboard_ref_read_info),
                       HID_INPUT_REPORT_CHARACTERISTIC(cc_ccc, cc_ref_read_info),
                       HID_OUTPUT_REPORT_CHARACTERISTIC(led_ref_read_info),

                       BT_GATT_CHARACTERISTIC(BT_UUID_HIDS_INFO, BT_GATT_CHRC_READ, BT_GATT_PERM_READ, fixed_read, NULL,
                                              &hid_info_read_info),
                       BT_GATT_CHARACTERISTIC(BT_UUID_HIDS_REPORT_MAP, BT_GATT_CHRC_READ, BT_GATT_PERM_READ, fixed_read,
                                              NULL, &hid_report_map_read_info),
                       BT_GATT_CHARACTERISTIC(BT_UUID_HIDS_CTRL_POINT, BT_GATT_CHRC_WRITE_WITHOUT_RESP,
                                              BT_GATT_PERM_WRITE, NULL, write_noop, NULL), );

static const struct bt_gatt_attr *mouse_attr;
static const struct bt_gatt_attr *keyboard_attr;
static const struct bt_gatt_attr *cc_attr;
static const struct bt_gatt_attr *led_attr;

void hog_init(void) {
  for (int i = 0; i < hog_svc.attr_count; i++) {
    const struct bt_gatt_attr *attr = &hog_svc.attrs[i];

    if (bt_uuid_cmp(attr->uuid, BT_UUID_HIDS_REPORT) != 0) {
      continue;
    }

    if (attr->user_data == &mouse_ref_read_info) {
      mouse_attr = attr;
    } else if (attr->user_data == &keyboard_ref_read_info) {
      keyboard_attr = attr;
    } else if (attr->user_data == &cc_ref_read_info) {
      cc_attr = attr;
    } else if (attr->user_data == &led_ref_read_info) {
      led_attr = attr;
    }
  }

  if (mouse_attr == NULL || keyboard_attr == NULL || cc_attr == NULL || led_attr == NULL) {
    LOG_ERR("Failed to find HID attributes");
  }

  LOG_INF("HID attributes found");
}

int hog_notify(struct bt_conn *conn, uint8_t report_id, uint8_t *data, uint8_t len) {
  switch (report_id) {
  case HID_RPT_ID_MOUSE_IN:
    return bt_gatt_notify(conn, mouse_attr, data, len);
    break;
  case HID_RPT_ID_KEY_IN:
    return bt_gatt_notify(conn, keyboard_attr, data, len);
    break;
  case HID_RPT_ID_CC_IN:
    return bt_gatt_notify(conn, cc_attr, data, len);
    break;
  default:
    LOG_ERR("Unknown report ID %u", report_id);
    return -EINVAL;
    break;
  }
}
```

## src/hog.h
```c
#ifndef HOG_H
#define HOG_H

#include <stdint.h>
#include <zephyr/bluetooth/bluetooth.h>

#define HID_RPT_ID_KEY_IN 0x02
#define HID_RPT_ID_LED_OUT 0x02
#define HID_RPT_ID_MOUSE_IN 0x01
#define HID_RPT_ID_CC_IN 0x03

void hog_init(void);
int hog_notify(struct bt_conn *conn, uint8_t report_id, uint8_t *data, uint8_t len);

#endif /* HOG_H */
```

## src/pair.c
```c
#include "pair.h"
#include "zephyr/bluetooth/bluetooth.h"
#include "zephyr/bluetooth/conn.h"
#include "zephyr/logging/log.h"

LOG_MODULE_REGISTER(pair);

static void bt_auth_cancel(struct bt_conn *conn) {
  char addr[BT_ADDR_LE_STR_LEN];
  bt_addr_le_to_str(bt_conn_get_dst(conn), addr, sizeof(addr));
  LOG_INF("Pairing cancelled: %s", addr);
}

static void bt_pairing_confirm(struct bt_conn *conn) {
  char addr[BT_ADDR_LE_STR_LEN];
  bt_addr_le_to_str(bt_conn_get_dst(conn), addr, sizeof(addr));
  LOG_INF("Pairing confirm: %s", addr);

  int err = bt_conn_auth_pairing_confirm(conn);
  if (err) {
    LOG_ERR("Pairing confirm failed (err %d)", err);
    return;
  }

  LOG_INF("Pairing confirm success: %s", addr);
}

static struct bt_conn_auth_cb auth_cb_display = {
    .pairing_confirm = bt_pairing_confirm,
    .cancel = bt_auth_cancel,
};

int register_auth_callbacks(void) {
    return bt_conn_auth_cb_register(&auth_cb_display);
}
```

## src/pair.h
```c
#pragma once

int register_auth_callbacks(void);
```

## src/registry.c
```c
#include "registry.h"
#include "zephyr/bluetooth/addr.h"
#include "zephyr/bluetooth/conn.h"
#include "zephyr/logging/log.h"

LOG_MODULE_REGISTER(registry);

static control_block_t control_blocks[CONFIG_BT_MAX_CONN] = {0};

int register_connection(struct bt_conn *conn) {
  for (int i = 0; i < CONFIG_BT_MAX_CONN; i++) {
    if (control_blocks[i].conn == NULL) {
      control_blocks[i].conn = conn;
      const bt_addr_le_t *addr = bt_conn_get_dst(conn);
      bt_addr_le_copy(&control_blocks[i].addr, addr);

      char addr_s[BT_ADDR_LE_STR_LEN];
      bt_addr_le_to_str(addr, addr_s, sizeof(addr_s));
      LOG_INF("Assigned connection %d to %s", i, addr_s);

      return i;
    }
  }

  return -1; // No available control block
}

control_block_t *get_control_block(struct bt_conn *conn) {
  const bt_addr_le_t *addr = bt_conn_get_dst(conn);

  for (int i = 0; i < CONFIG_BT_MAX_CONN; i++) {
    if (control_blocks[i].conn != NULL && bt_addr_le_cmp(addr, &control_blocks[i].addr) == 0) {
      return &control_blocks[i];
    }
  }

  return NULL; // Connection not found
}

control_block_t *get_control_block_by_index(int index) {
  if (index < 0 || index >= CONFIG_BT_MAX_CONN) {
    return NULL; // Invalid index
  }

  control_block_t *cb = &control_blocks[index];
  if (cb->conn == NULL) {
    return NULL; // Control block not initialized
  }

  return &control_blocks[index];
}

int unregister_connection(struct bt_conn *conn) {
  control_block_t *cb = get_control_block(conn);
  if (cb) {
    char addr_s[BT_ADDR_LE_STR_LEN];
    bt_addr_le_to_str(&cb->addr, addr_s, sizeof(addr_s));

    memset(cb, 0, sizeof(control_block_t));

    LOG_INF("Unregistered connection %s", addr_s);
  }
  return -1; // Connection not found
}

int count_connected_devices(void) {
  int count = 0;
  for (int i = 0; i < CONFIG_BT_MAX_CONN; i++) {
    if (control_blocks[i].conn != NULL) {
      count++;
    }
  }
  return count;
}

bool is_control_blocks_full(void) {
  for (int i = 0; i < CONFIG_BT_MAX_CONN; i++) {
    if (control_blocks[i].conn == NULL) {
      return false;
    }
  }
  return true;
}
```

## src/registry.h
```c
#pragma once
#include <stddef.h>
#include <zephyr/device.h>
#include <zephyr/bluetooth/bluetooth.h>

typedef struct {
    bt_addr_le_t addr;
    struct bt_conn *conn;
} control_block_t;

int register_connection(struct bt_conn *conn);
control_block_t *get_control_block(struct bt_conn *conn);
control_block_t *get_control_block_by_index(int index);
int unregister_connection(struct bt_conn *conn);
int count_connected_devices(void);
bool is_control_blocks_full(void);
```
